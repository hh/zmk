## app/dts/bindings/behaviors/zmk,behavior-inputstick.yaml
```yaml
# Copyright (c) 2024 The ZMK Contributors
# SPDX-License-Identifier: MIT

description: InputStick Target Selection Behavior

compatible: "zmk,behavior-inputstick"

include: two_param.yaml
```

## app/src/hogp/Kconfig
```kconfig
# Copyright (c) 2024 The ZMK Contributors
# SPDX-License-Identifier: MIT

menuconfig ZMK_HOGP
    bool "BLE HID Central (HOGP) for external pointing devices"
    depends on BT_CENTRAL
    select BT_GATT_CLIENT
    select BT_GATT_AUTO_DISCOVER_CCC
    help
      Enable HOGP (HID over GATT Profile) central role to connect
      to external BLE HID devices like mice and trackpads, and
      forward their input through the keyboard's active output.

      Note: You may need to set CONFIG_BT_SMP_SC_PAIR_ONLY=n in your
      prj.conf if connecting to devices that use Legacy Pairing.

if ZMK_HOGP

config ZMK_HOGP_MAX_DEVICES
    int "Maximum simultaneous HOGP devices"
    default 1
    range 1 2
    help
      Maximum number of BLE HID peripherals that can be connected
      simultaneously. Each device uses a BT connection slot.

config ZMK_HOGP_AUTO_RECONNECT
    bool "Auto-reconnect to bonded HOGP devices on boot"
    default y
    help
      Automatically scan for and reconnect to previously bonded
      HOGP devices when the keyboard starts up.

config ZMK_HOGP_SCAN_DURATION_SEC
    int "Scan duration in seconds (0 = indefinite)"
    default 30
    help
      How long to scan for devices before stopping.
      Set to 0 for indefinite scanning.

config ZMK_HOGP_MOUSE_OUTPUT
    bool "Forward trackpad as mouse movement"
    default y
    depends on ZMK_POINTING
    help
      Convert single-finger trackpad touches to relative mouse movement.
      This provides basic cursor control without multitouch gestures.

config ZMK_HOGP_MOUSE_SENSITIVITY
    int "Mouse sensitivity divisor"
    default 4
    depends on ZMK_HOGP_MOUSE_OUTPUT
    help
      Divide trackpad coordinates by this value when converting to mouse delta.
      Higher values = slower cursor movement.
      Typical values: 2 (fast), 4 (medium), 8 (slow)

config ZMK_HOGP_TRACKPAD_OUTPUT
    bool "Forward as ADG multitouch trackpad (ProtoArc)"
    default n
    help
      Present as Apple ADG Chapter 15 compliant trackpad.
      Full multitouch gesture support on Linux/iPadOS/macOS.
      Adds trackpad report to the HID report descriptor.
      Use this for ProtoArc and similar Windows PTP trackpads.

config ZMK_HOGP_ITRACK_OUTPUT
    bool "Forward as ADG multitouch trackpad (Brydge iTrack)"
    default n
    help
      Support for Brydge iTrack trackpad with confidence bit fix.
      The iTrack has a firmware bug where it reports confidence=0
      when fingers are close together, breaking pinch gestures.
      This option applies the fix and forwards as ADG multitouch.

module = ZMK_HOGP
module-str = zmk_hogp
source "subsys/logging/Kconfig.template.log_config"

endif # ZMK_HOGP

menuconfig ZMK_INPUTSTICK
    bool "InputStick client (drive a USB HID dongle over BLE)"
    depends on BT_CENTRAL
    select BT_GATT_CLIENT
    select BT_GATT_AUTO_DISCOVER_CCC
    select CRC
    help
      Act as a BLE central to an InputStick USB HID dongle, which presents
      itself to whatever machine it is plugged into as a plain USB keyboard
      and mouse. This lets the keyboard type into a host it has never paired
      with -- useful for machines that cannot accept a BLE keyboard at all
      (BIOS screens, KVMs, locked-down desktops).

      Unlike HOGP this is not a HID connection: the dongle speaks a framed
      binary protocol over Nordic UART Service, and needs no bonding, so it
      costs no BT_MAX_PAIRED slot.

if ZMK_INPUTSTICK

config ZMK_INPUTSTICK_SLOT_COUNT
    int "Number of InputStick target slots"
    default 1
    range 1 5
    help
      How many dongles can be remembered as separate output targets, each
      selectable like a BLE profile. A slot stores one dongle's BLE address
      so selecting it always reaches the same machine.

      These are NOT bonds -- an InputStick needs no pairing -- so unlike BLE
      profiles they cost nothing from CONFIG_BT_MAX_PAIRED.

config ZMK_INPUTSTICK_TX_QUEUE_SIZE
    int "Queued HID reports awaiting transmission"
    default 16
    help
      Depth of the HID report queue drained by the InputStick TX thread.
      Overflow drops the OLDEST report: a stale HID report is worthless, and
      applying back pressure to keyscan or the BT RX thread is the thing this
      queue exists to prevent.

config ZMK_INPUTSTICK_TX_STACK_SIZE
    int "InputStick TX work queue stack size"
    default 2048
    help
      Stack for the thread that performs the GATT writes.

config ZMK_INPUTSTICK_TX_THREAD_PRIORITY
    int "InputStick TX work queue thread priority"
    default 5
    help
      Preemptible, and lower priority than the BT RX thread so transmission
      never delays reception.

config ZMK_INPUTSTICK_THREAD_STACK_SIZE
    int "InputStick handshake thread stack size"
    default 2048
    help
      The handshake blocks on GATT writes and notification replies, so it
      cannot run on the BT RX thread or a workqueue and needs its own.

config ZMK_INPUTSTICK_TYPE_DELAY_MS
    int "Delay between characters when typing a string"
    default 20
    help
      Pause after each character sent by inputstick_type(). Too short and
      the dongle's USB side coalesces or drops repeats; 20ms matches the
      hardware-verified prototypes.

module = ZMK_INPUTSTICK
module-str = zmk_inputstick
source "subsys/logging/Kconfig.template.log_config"

endif # ZMK_INPUTSTICK

menuconfig ZMK_SERIAL_CMD
    bool "Serial command handler for USB logging console"
    depends on ZMK_USB_LOGGING
    default y if ZMK_HOGP
    help
      Enable serial commands over the USB CDC ACM console.
      Commands start with '!' prefix (e.g., !help, !pair, !reboot).

if ZMK_SERIAL_CMD

module = ZMK_SERIAL_CMD
module-str = zmk_serial_cmd
source "subsys/logging/Kconfig.template.log_config"

endif # ZMK_SERIAL_CMD
```
